## platform/marvell-prestera/sonic_fit.its
```
/dts-v1/;
  
/ {
    description = "U-Boot fitImage for SONIC Marvell Arm64";
    #address-cells = <1>;
  
    images {
        kernel_1 {
            description = "Linux Kernel";
            data = /incbin/("/boot/vmlinuz-6.1.0-29-2-arm64");
            type = "kernel";
            arch = "arm64";
            os = "linux";
            compression = "none";
            load = <0x1000000>;
            entry = <0x1000000>;
            hash@1 {
                algo = "sha1";
            };
        };
        ramdisk_1 {
            description = "ramdisk";
            data = /incbin/("/boot/initrd.img-6.1.0-29-2-arm64");
            type = "ramdisk";
            arch = "arm64";
            os = "linux";
            compression = "gzip";
            load = <0x6000000>;
            entry = <0x6000000>;
            hash@1 {
                algo = "sha1";
            };
        };
        fdt_cn9131 {
            description = "Flattened Device Tree blob";
            data = /incbin/("/boot/cn9131-db-comexpress.dtb");
            type = "flat_dt";
            arch = "arm64";
            compression = "none";
            load = <0x0a00000>;
            entry = <0x0a00000>;
            hash@1 {
                algo = "sha1";
            };
        };
    };
    configurations {
        default = "conf_cn9131";
        conf_cn9131 {
            description = "Boot Linux kernel with FDT blob + ramdisk for CN9131";
            kernel = "kernel_1";
            fdt = "fdt_cn9131";
            ramdisk = "ramdisk_1";
            hash@1 {
                algo = "sha1";
            };
        };
   };
};
```
